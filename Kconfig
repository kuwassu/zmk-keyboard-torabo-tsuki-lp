## config/west.yml
```yaml
manifest:
  remotes:
    - name: zmkfirmware
      url-base: https://github.com/zmkfirmware
    - name: sekigon-gonnoc
      url-base: https://github.com/sekigon-gonnoc
    - name: kuwassu
      url-base: https://github.com/kuwassu
    - name: cormoran
      url-base: https://github.com/cormoran
  projects:
    - name: zmk
      remote: cormoran
      # v0.3-branch+dya: the same v0.3-based fork used by upstream's DYA branch.
      revision: 4493783ef88ce2e653bf8217c92ee17140df71e3
      import: app/west.yml
    - name: zmk-component-bmp-boost
      remote: sekigon-gonnoc
      import: west.yml
      revision: v0.2
    - name: zmk-feature-status-led
      remote: sekigon-gonnoc
      revision: main
    - name: zmk-driver-paw3222
      remote: sekigon-gonnoc
      revision: torabo-tsuki
    - name: zmk-driver-iqs7211e
      remote: sekigon-gonnoc
    - name: zmk-feature-cdc-acm-bootloader-trigger
      remote: sekigon-gonnoc
      revision: v0.2
    - name: zmk-feature-non-lipo-battery-management
      remote: sekigon-gonnoc
      revision: main
    - name: zmk-mouse-gesture
      remote: kuwassu
      revision: v1
    - name: zmk-driver-kscan-4-direction-switch
      remote: sekigon-gonnoc
    - name: zmk-driver-hires-dial
      remote: sekigon-gonnoc
    # DYA modules pinned to their zmk-v0.3.0.0 tags.
    # BLE management is vendored in modules/ to support all seven host slots.
    - name: zmk-module-settings-rpc
      remote: cormoran
      revision: ad1c995cf910ca989ecd6352a1d0b41ccb18362c
    - name: zmk-module-runtime-input-processor
      remote: cormoran
      revision: dbf92f764de8b6ffd60bf5850514302875fe2570
  self:
    path: config
```

## dts/bindings/behaviors/torabo,behavior-thumb-shift.yaml
```yaml
description: Hold ordinary left Shift and enable pointing gestures until release
compatible: "torabo,behavior-thumb-shift"
include: zero_param.yaml

properties:
  gesture-layer:
    type: int
    required: true
  gesture-behavior:
    type: phandle
    required: true
```
