## dts/bindings/behaviors/torabo,behavior-scroll-mode.yaml
```yaml
description: Select a scroll axis until the scroll layer changes
compatible: "torabo,behavior-scroll-mode"
include: one_param.yaml

properties:
  scroll-layers:
    type: array
    required: true
    description: Layer changes that reset the mode to free scrolling
```

## dts/bindings/input_processors/torabo,input-processor-scroll-axis.yaml
```yaml
description: Suppress the unselected scroll axis without dropping event synchronization
compatible: "torabo,input-processor-scroll-axis"
include: ip_zero_param.yaml
```
